## drivers/sensors/Kconfig
```kconfig
menu "Sensors Support"

config SENSORS
	tristate "Generic sensors layer (needed for mpu6050, ...)"
	default y
	help
	  Say Y here if you have any sensors

if SENSORS

config SENSORS_MPU6050
	tristate  "mpu6050 detect support"
	default y
	depends on I2C
	help
	  Help yourself.........

config SENSORS_ENCODER
	tristate  "encode detect support"
	default y
	help
	  Help yourself.........
	  
endif



endmenu
```
